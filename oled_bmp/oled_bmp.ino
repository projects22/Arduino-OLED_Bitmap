/*
 * oled Image
 *
 * Created: 10/01/2021
 *  Author: moty22.co.uk
 */ 
#include <Wire.h>
//#include "oled_font.c"

unsigned char addr=0x3C;  //0x78
//unsigned char v, h, c;

const unsigned char img1[] = {  //toothwheel
0x00, 0x00, 0x00, 0x00, 0x00, 0x00, 0x80, 0x80, 0x80, 0x80, 0x00, 0x00, 0x00, 0x00, 0xFC, 0xFE,
0xFE, 0xFE, 0xFF, 0xFF, 0xFC, 0xF8, 0xF0, 0xE0, 0xF0, 0xF8, 0xFE, 0xFF, 0xFF, 0xFF, 0xFF, 0xFE,
0xFE, 0x80, 0x80, 0x80, 0x80, 0xC0, 0xE0, 0xE0, 0xE0, 0xC0, 0x80, 0x00, 0x00, 0x00, 0x00, 0x00,
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0x03, 0x03, 0x07, 0x0F, 0x1F, 0x1F, 0x0F, 0x07, 0x03, 0x00, 0x00, 0x00, 0x00, 0x00, 0x00, 0x00
};


const unsigned char img2[] = { //globe
0x00, 0x00, 0x00, 0x00, 0x00, 0x00, 0x80, 0xC0, 0xC0, 0xE0, 0xF0, 0xF0, 0xF8, 0x7C, 0x7C, 0xFE,
0xFE, 0xFE, 0x7E, 0x3F, 0x1F, 0x0F, 0x0F, 0xFF, 0xFF, 0xFF, 0x0F, 0x0F, 0x1F, 0x3F, 0x7E, 0xFE,
0xFE, 0xFC, 0x7C, 0xF8, 0xF8, 0xF0, 0xF0, 0xE0, 0xC0, 0x80, 0x00, 0x00, 0x00, 0x00, 0x00, 0x00,
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0xFF, 0x7F, 0x7C, 0x3E, 0x3E, 0x1F, 0x1F, 0x0F, 0x07, 0x03, 0x01, 0x00, 0x00, 0x00, 0x00, 0x00
};

void setup() {
    pinMode(7, INPUT_PULLUP);
    Wire.begin();        // init i2c bus
    Wire.setClock(400000);  //400khz
    oled_init();
    clrScreen();
}

void loop()
{
    draw(img1, 10,70);  //image array,y,x
    draw(img2, 0,0);

    delay(5000);
    clrScreen();
    delay(2000);
}

void draw(unsigned char *bmp, unsigned char y, unsigned char x)    // draw bitmap 
{
        unsigned char v, h, c;
    
        for (h = 0; h < 6;++h){
           for (c = 0; c < 3;++c){
              command(0x21);     //col addr
              command(x+c*16); //col start //0/0+c*16
              command(x+16+c*16);  //col end  //31/16+c*16
              command(0x22);    //0x22
              command(h+y); // Page start
              command(h+1+y); // Page end

              Wire.beginTransmission(addr);
              Wire.write(0x40);
              for (v = 0+c*16; v < 16+c*16; ++v){
                 Wire.write(bmp[v+48*h]);    //v+(32*h)
              }
              Wire.endTransmission();      
           }
        }
}

void clrScreen()    //fill screen with 0
{
    unsigned char y, x;
    
    for ( y = 0; y < 8; y++ ) {
      for (x = 0; x < 17; x++){
          command(0x21);     //col addr
          command(8 * x); //col start
          command(8 * x + 7);  //col end
          command(0x22);    //0x22
          command(y); // Page start
          command(y); // Page end
          
          Wire.beginTransmission(addr);
          Wire.write(0x40);
          for (unsigned char i = 0; i < 8; i++){
               Wire.write(0x00);          
          }
          Wire.endTransmission();         
      }
     
    }
    
}

void command( unsigned char comm){
    Wire.beginTransmission(addr); 
    Wire.write(0x00);    
    Wire.write(comm); // LSB
    Wire.endTransmission();       
}

void oled_init() {
    
    command(0xAE);   // DISPLAYOFF
    command(0x8D);         // CHARGEPUMP *
    command(0x14);     //0x14-pump on
    command(0x20);         // MEMORYMODE
    command(0x0);      //0x0=horizontal, 0x01=vertical, 0x02=page
    command(0xA1);        //SEGREMAP * A0/A1=top/bottom 
    command(0xC8);     //COMSCANDEC * C0/C8=left/right
    command(0xDA);         // SETCOMPINS *
    command(0x12);   //0x22=4rows, 0x12=8rows
    command(0x81);        // SETCONTRAST
    command(0x9F);     //0x8F
    //following settings are set by default
//    command(0xD5);  //SET DISPLAY CLOCK DIV 
//    command(0x80);  
//    command(0xA8);       // SETMULTIPLEX
//    command(0x3F);     //0x1F
//    command(0xD3);   // SETDISPLAYOFFSET
//    command(0x0);  
//    command(0x40); // SETSTARTLINE  
//    command(0xD9);       // SETPRECHARGE
//    command(0xF1);
//    command(0xDB);      // SETVCOMDETECT
//    command(0x40);
//    command(0xA4);     // DISPLAYALLON_RESUME
//    command(0xA6);      // NORMALDISPLAY
    command(0xAF);          //DISPLAYON

}
