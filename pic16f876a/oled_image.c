//OLED Image PIC16F876A
//MPLAB X v3.10 xc8 v1.45
//moty22.co.uk


//#include <pic16f876a.h>
#include <xc.h>

#pragma config LVP=OFF, FOSC=HS, CP=OFF, CPD=OFF, WDTE=OFF

#define _XTAL_FREQ 8000000

// prototypes
void command( unsigned char comm);
void oled_init();
void clrScreen();
void sendData(unsigned int dataB);
void startBit(void);
void stopBit(void);
void draw(unsigned char *bmp, unsigned char y, unsigned char x);   //unsigned char bmp[250],  

const unsigned char img1[] = {   //toothwheel
0x00, 0x00, 0x00, 0x00, 0x00, 0x00, 0x80, 0x80, 0x80, 0x80, 0x00, 0x00, 0x00, 0x00, 0xFC, 0xFE,
0xFE, 0xFE, 0xFF, 0xFF, 0xFC, 0xF8, 0xF0, 0xE0, 0xF0, 0xF8, 0xFE, 0xFF, 0xFF, 0xFF, 0xFF, 0xFE,
0xFE, 0x80, 0x80, 0x80, 0x80, 0xC0, 0xE0, 0xE0, 0xE0, 0xC0, 0x80, 0x00, 0x00, 0x00, 0x00, 0x00,
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0x03, 0x03, 0x07, 0x0F, 0x1F, 0x1F, 0x0F, 0x07, 0x03, 0x00, 0x00, 0x00, 0x00, 0x00, 0x00, 0x00
};


const unsigned char img2[] = {  //globe
0x00, 0x00, 0x00, 0x00, 0x00, 0x00, 0x80, 0xC0, 0xC0, 0xE0, 0xF0, 0xF0, 0xF8, 0x7C, 0x7C, 0xFE,
0xFE, 0xFE, 0x7E, 0x3F, 0x1F, 0x0F, 0x0F, 0xFF, 0xFF, 0xFF, 0x0F, 0x0F, 0x1F, 0x3F, 0x7E, 0xFE,
0xFE, 0xFC, 0x7C, 0xF8, 0xF8, 0xF0, 0xF0, 0xE0, 0xC0, 0x80, 0x00, 0x00, 0x00, 0x00, 0x00, 0x00,
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0xFF, 0x7F, 0x7C, 0x3E, 0x3E, 0x1F, 0x1F, 0x0F, 0x07, 0x03, 0x01, 0x00, 0x00, 0x00, 0x00, 0x00
};

unsigned int addr=0x78;  //

void main(void) {
    
    	// PIC I/O init
    ADCON1 = 0b110;     //digital inputs 
    TRISC = 0b11101;		// scl=rc3, sda=rc4
    
	//i2c init
	SMP=1;	//slew rate 100khz
	CKE=0;	//SMBus dis
	SSPADD = 9; //200khz
	SSPCON = 0B101000;	//SSPEN=1, Master mode, clock = FOSC / (4 * (SSPADD+1))
	SSPCON2 = 0;
    __delay_ms(100);

    oled_init();   // oled init
    clrScreen();       // clear screen

    while (1) {
        draw(img1, 10,70);  //image array,y,x
        draw(img2, 0,0);

        __delay_ms(12000);
//        clrScreen();
//        __delay_ms(2000);
        
	}
}
 
void draw(unsigned char *bmp, unsigned char y, unsigned char x)    //  
{
        unsigned char v, h;
    
        for (h = 0; h < 6;++h){
 
              command(0x21);     //col addr x
              command(0+x); //col start
              command(48+x);  //col end
              command(0x22);    //0x22 y
              command(h+y); // Page start
              command(h+1+y); // Page end

              startBit();
              sendData(addr);            // address
              sendData(0x40);
              for (v = 0; v < 48; ++v){
                 sendData(bmp[v+48*h]);
                 //sendData(255-(bmp[v+48*h])); //use this line for swapping black and white
              }
              stopBit();      

        }
}

void clrScreen()    //fill screen with 0
{
    unsigned char y, i;
    
    for ( y = 0; y < 8; y++ ) {
        command(0x21);     //col addr
        command(0); //col start
        command(127);  //col end
        command(0x22);    //0x22
        command(y); // Page start
        command(y+1); // Page end    
        startBit();
        sendData(addr);            // address
        sendData(0x40);
        for (i = 0; i < 128; i++){
             sendData(0x00);
        }
        stopBit();
    }    
}

void sendData(unsigned int dataB)
{
    SSPIF=0;          // clear interrupt
    SSPBUF = dataB;              // send dataB
    while(!SSPIF);    // Wait to send
}

void startBit(void)
{
    SSPIF=0;
    SEN=1;          // start bit
    while(!SSPIF);
}

void stopBit(void)
{
    SSPIF=0;
    PEN=1;          // send stop
    while(!SSPIF);
}

void command( unsigned char comm){
    
    startBit();
    sendData(addr);            // address
    sendData(0x00);
    sendData(comm);             // command code
    stopBit();
}

void oled_init() {
    
    command(0xAE);   // DISPLAYOFF
    command(0x8D);         // CHARGEPUMP *
    command(0x14);     //0x14-pump on
    command(0x20);         // MEMORYMODE
    command(0x0);      //0x0=horizontal, 0x01=vertical, 0x02=page
    command(0xA1);        //SEGREMAP * A0/A1=top/bottom 
    command(0xC8);     //COMSCANDEC * C0/C8=left/right
    command(0xDA);         // SETCOMPINS *
    command(0x12);   //0x22=4rows, 0x12=8rows
    command(0x81);        // SETCONTRAST
    command(0x9F);     //0x8F
    //next settings are set by default
//    command(0xD5);  //SETDISPLAYCLOCKDIV 
//    command(0x80);  
//    command(0xA8);       // SETMULTIPLEX
//    command(0x3F);     //0x1F
//    command(0xD3);   // SETDISPLAYOFFSET
//    command(0x0);  
//    command(0x40); // SETSTARTLINE  
//    command(0xD9);       // SETPRECHARGE
//    command(0xF1);
//    command(0xDB);      // SETVCOMDETECT
//    command(0x40);
//    command(0xA4);     // DISPLAYALLON_RESUME
 //   command(0xA6);      // NORMALDISPLAY
    command(0xAF);          //DISPLAYON

}



